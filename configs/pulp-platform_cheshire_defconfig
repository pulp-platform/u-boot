## configs/pulp-platform_cheshire_defconfig
```kconfig
CONFIG_RISCV=y
CONFIG_DEFAULT_DEVICE_TREE="pulp-platform_cheshire"
CONFIG_TARGET_PULP_PLATFORM_CHESHIRE=y
CONFIG_ARCH_RV64I=y
CONFIG_RISCV_SMODE=y
CONFIG_OF_LIBFDT=y
CONFIG_OF_BOARD_SETUP=y
CONFIG_OF_PRIOR_STAGE=y
CONFIG_BOOTDELAY=5
CONFIG_HUSH_PARSER=y
CONFIG_USE_BOOTCOMMAND=y
# Boot with mmc if mmc probes normally, else boot with spi (get CS from "boot-with" in device tree)
CONFIG_BOOTCOMMAND="fdt addr ${fdtcontroladdr}; if mmc info; then mmc read 90000000 2000 5000; else fdt get value boot-with /soc/spi boot-with; if sf probe 0:${boot-with}; then sf read 90000000 400000 800000; fi; fi; bootm 90000000 - ${fdtcontroladdr};"
CONFIG_DISPLAY_CPUINFO=y
CONFIG_SPL_SPI_FLASH_MTD=y
CONFIG_CMD_GPT=y
# CONFIG_RANDOM_UUID is not set
CONFIG_CMD_MMC=y
CONFIG_CMD_MTD=y
CONFIG_CMD_PART=y
CONFIG_OF_EMBED=n
CONFIG_MMC=y
# CONFIG_MMC_WRITE is not set
CONFIG_MMC_SPI=y
CONFIG_DM_MTD=y
CONFIG_MTDIDS_DEFAULT="nor0=spi0.0"
CONFIG_MTDPARTS_DEFAULT="mtdparts=spi0.0:-(all)"
CONFIG_DM_DEBUG=y
CONFIG_MTD_SPI_NAND=y
CONFIG_MTD_SPI_NOR=y
CONFIG_SPI_FLASH_ATMEL=y
CONFIG_SPI_FLASH_EON=y
CONFIG_SPI_FLASH_GIGADEVICE=y
CONFIG_SPI_FLASH_ISSI=y
CONFIG_SPI_FLASH_MACRONIX=y
CONFIG_SPI_FLASH_SPANSION=y
CONFIG_SPI_FLASH_STMICRO=y
CONFIG_SPI_FLASH_SST=y
CONFIG_SPI_FLASH_WINBOND=y
CONFIG_SPI_FLASH_XMC=y
# CONFIG_SPI_FLASH_USE_4K_SECTORS is not set
CONFIG_SPI_FLASH_MTD=y
CONFIG_SYS_NS16550=y
CONFIG_SPI=y
CONFIG_OPENTITAN_QSPI=y
CONFIG_LOG=y
CONFIG_LOGLEVEL=9
CONFIG_LOG_MAX_LEVEL=9
#CONFIG_LOGF_FUNC=y
#CONFIG_LOG_ERROR_RETURN=y
#CONFIG_BOOTSTAGE_REPORT=y
```

## configs/pulp-platform_occamy_defconfig
```kconfig
CONFIG_RISCV=y
CONFIG_SYS_MALLOC_F_LEN=0x3000
CONFIG_DM_GPIO=y
CONFIG_SPL_DM_SPI=y
CONFIG_SPL=y
CONFIG_SPL_SPI_FLASH_SUPPORT=y
CONFIG_SPL_SPI_SUPPORT=y
CONFIG_DEFAULT_DEVICE_TREE="occamy"
CONFIG_TARGET_PULP_PLATFORM_OCCAMY=y
CONFIG_ARCH_RV64I=y
CONFIG_RISCV_SMODE=y
CONFIG_FIT=y
CONFIG_SPL_LOAD_FIT_ADDRESS=0x90000000
CONFIG_OF_BOARD_SETUP=y
CONFIG_BOOTDELAY=5
CONFIG_USE_BOOTCOMMAND=y
CONFIG_BOOTCOMMAND="fdt addr ${fdtcontroladdr}; fdt get value remote-boot /soc/eth0 remote-boot; dhcp 0x90000000 ${remote-boot}; bootm 90000000 - ${fdtcontroladdr}"
CONFIG_USE_BOOTARGS=y
CONFIG_BOOTARGS="earlyprintk"
CONFIG_LOG=y
CONFIG_LOG_MAX_LEVEL=9
CONFIG_LOGF_FUNC=y
CONFIG_LOG_ERROR_RETURN=y
CONFIG_DISPLAY_CPUINFO=y
CONFIG_SPL_MTD_SUPPORT=y
CONFIG_SPL_DM_SPI_FLASH=y
CONFIG_SPL_RAM_SUPPORT=y
CONFIG_SPL_RAM_DEVICE=y
CONFIG_SPL_SPI_FLASH_MTD=y
CONFIG_SPL_SPI_LOAD=y
CONFIG_CMD_MEMTEST=n
CONFIG_CMD_GPIO=n
CONFIG_CMD_I2C=y
CONFIG_CMD_SF_TEST=y
CONFIG_CMD_AXI=n
CONFIG_CMD_DHCP=y
CONFIG_CMD_MII=y
CONFIG_CMD_PING=y
CONFIG_CMD_DNS=n
CONFIG_CMD_MTDPARTS=y
CONFIG_CMD_FDT=y
CONFIG_MTDIDS_DEFAULT="nor0=spi0.0"
CONFIG_MTDPARTS_DEFAULT="mtdparts=spi0.0:96m(bitstream),1m(u-boot),16m(uimage),-(filesystem)"
CONFIG_OF_PRIOR_STAGE=y
CONFIG_PROT_UDP=y
CONFIG_NET_RANDOM_ETHADDR=y
CONFIG_AXI=y
CONFIG_DM_PCA953X=y
CONFIG_DM_I2C=y
CONFIG_SYS_I2C_XILINX_XIIC=y
CONFIG_I2C_MUX=y
CONFIG_I2C_MUX_PCA954x=y
CONFIG_DM_MTD=y
CONFIG_SPI_FLASH_ATMEL=y
CONFIG_SPI_FLASH_EON=y
CONFIG_SPI_FLASH_GIGADEVICE=y
CONFIG_SPI_FLASH_ISSI=y
CONFIG_SPI_FLASH_MACRONIX=y
CONFIG_SPI_FLASH_SPANSION=y
CONFIG_SPI_FLASH_STMICRO=y
CONFIG_SPI_FLASH_SST=y
CONFIG_SPI_FLASH_WINBOND=y
CONFIG_SPI_FLASH_XMC=y
# CONFIG_SPI_FLASH_USE_4K_SECTORS is not set
CONFIG_SPI_FLASH_MTD=y
CONFIG_PHY_TI_DP83867=y
CONFIG_PHY_XILINX=y
CONFIG_DM_MDIO=y
CONFIG_DM_ETH_PHY=y
CONFIG_XILINX_AXIEMAC=y
CONFIG_PHY=y
CONFIG_SYS_NS16550=y
CONFIG_SPI=y
CONFIG_XILINX_SPI=y
CONFIG_CLINT_TIMER=y
CONFIG_LOGLEVEL=8
CONFIG_SPL_LOGLEVEL=8
CONFIG_TPL_LOGLEVEL=8
CONFIG_DM_DEBUG=1
```
